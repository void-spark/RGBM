## sdkconfig.defaults
```kconfig
CONFIG_IDF_TARGET="esp32c3"

# My chips are 4MB flash, once you use OTA this settings matters
CONFIG_ESPTOOLPY_FLASHSIZE_4MB=y

# Set up partitions for OTA
CONFIG_PARTITION_TABLE_TWO_OTA=y

# Yes we know what we're doing and want plain HTTP
CONFIG_OTA_ALLOW_HTTP=y

CONFIG_ESP32C3_DEFAULT_CPU_FREQ_160=y
CONFIG_FREERTOS_HZ=1000

# Disable fancy MQTT things we don't want
CONFIG_MQTT_TRANSPORT_SSL=
CONFIG_MQTT_TRANSPORT_WEBSOCKET=
```
